#include "nokia5110.h"
#include <Arduino.h>

byte lineMatrix[LCD_WIDTH * LCD_HEIGHT / 8] = {
0x00, 0x00, 0x00, 0x00, 0x00, 0x00, 0x00, 0x00, 0x00, 0x00, 0x00, 0x00, //Linha 0
0x00, 0x00, 0x00, 0x00, 0x00, 0x00, 0x00, 0x00, 0x00, 0x00, 0x00, 0x00, 
0x00, 0x00, 0x00, 0x00, 0x00, 0x00, 0x00, 0x00, 0x00, 0x00, 0x00, 0x00, 
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0x00, 0x00, 0x00, 0x00, 0x00, 0x00, 0x00, 0x00, 0x00, 0x00, 0x00, 0x00
};


void initializeDisplay(byte vop, byte tempCoef, byte bias)
{
  pinMode(RST, OUTPUT);
  pinMode(DC, OUTPUT);
  pinMode(DIN, OUTPUT);
  pinMode(CLK, OUTPUT);
  digitalWrite(RST, LOW);
  digitalWrite(RST, HIGH);

  LcdWriteCmd(0x21);  // LCD extended commands 0010 0001 --- 0010 PD V H   PowerDown = 0, V = 0, H = 1
  //V = 0 para ativar escrita horizontal
  //H = 1 para ativar comandos adicionais
  
  LcdWriteCmd(vop);  // set LCD Vop (contrast) 1011 1111 Constrate setado para C0 = 5V
//Example: If user wants value of VLCD at 5 volt
//5 = 3.06 + (VOP6 to VOP0) x 0.06
//(VOP6 to VOP0) = (5 - 3.06) / 0.06
// (VOP6 to VOP0) = 32.33 approximately 32 (20H) or 0100000B
//So, the command that will be sent to LCD to set value of VOP
//is 11000000B or C0H. 

  LcdWriteCmd(tempCoef);  // set temp coefficent 0000 0100 Coeficiente de temperatura para o 3
  //empirico
  
  LcdWriteCmd(bias);  // LCD bias mode 1:40 0001 0100
  //Valor ótimo dado pelo datasheet
  
  LcdWriteCmd(0x20);  // LCD basic commands 0010 0000
  //retornar para os comandos básicos
  
  LcdWriteCmd(0x0C);  // LCD normal video 0000 1100
  //Coloca o LCD no modo normal
}

void setPixel(int x, int y, boolean bw)
{
  // First, double check that the coordinate is in range.
  if ((x >= 0) && (x < LCD_WIDTH) && (y >= 0) && (y < LCD_HEIGHT))
  {
    byte shift = y % 8;

    if (bw) // If black, set the bit.
      lineMatrix[x + (y/8)*LCD_WIDTH] |= 1<<shift;
    else   // If white clear the bit.
      lineMatrix[x + (y/8)*LCD_WIDTH] &= ~(1<<shift);
  }
}

void clearFrameBuffer()
{
  LcdXY(0,0);
  for(int i = 0 ; i < 504; i++) {
    lineMatrix[i] = 0x00; // clear LCD
  }
}

void clearScreen()
{
  for(int i=0; i<505; i++) LcdWriteData(0x00); // clear LCD
}

void writeBuffer()
{
  LcdXY(0,0);
  for(int i = 0 ; i < 504; i++) {
    LcdWriteData(lineMatrix[i]); // clear LCD
  }
}

void setText(int x, int y, char *characters) {

  int shift = 0;
  while(*characters) {

    if(x > 0 &&
     (x+shift < LCD_WIDTH-6) && 
     (y < LCD_HEIGHT-8) 
     && y > 0) {
      setCharacter(x+shift,y,*characters++);
      shift = shift + 6;
    }
    else
    {
      return;
    }
  }
}

void setCharacter(int x, int y, char character) {
    
    
    if ((x >= 0) && (x < LCD_WIDTH-6) && (y >= 0) && (y < LCD_HEIGHT-8))
    {
        byte shift = y % 8;

        for(int i = 0; i < 5; i++) {
          byte temp = pgm_read_byte_near(ASCII + ((character - 0x20)*5) + i);
          lineMatrix[(x + (y/8)*LCD_WIDTH) + i] = temp;
        }

    }


}

void setLine(int x0, int y0, int x1, int y1, boolean bw)
{
  int dy = y1 - y0; // Difference between y0 and y1
  int dx = x1 - x0; // Difference between x0 and x1
  int stepx, stepy;

  if (dy < 0)
  {
    dy = -dy;
    stepy = -1;
  }
  else
    stepy = 1;

  if (dx < 0)
  {
    dx = -dx;
    stepx = -1;
  }
  else
    stepx = 1;

  dy <<= 1; // dy is now 2*dy
  dx <<= 1; // dx is now 2*dx
  setPixel(x0, y0, bw); // Draw the first pixel.

  if (dx > dy)
  {
    int fraction = dy - (dx >> 1);
    while (x0 != x1)
    {
      if (fraction >= 0)
      {
        y0 += stepy;
        fraction -= dx;
      }
      x0 += stepx;
      fraction += dy;
      setPixel(x0, y0, bw);
    }
  }
  else
  {
    int fraction = dx - (dy >> 1);
    while (y0 != y1)
    {
      if (fraction >= 0)
      {
        x0 += stepx;
        fraction -= dy;
      }
      y0 += stepy;
      fraction += dx;
      setPixel(x0, y0, bw);
    }
  }
}

void LcdWriteString(char *characters)
{
  while(*characters) LcdWriteCharacter(*characters++);
}

void LcdWriteCharacter(char character)
{
  for(int i=0; i<5; i++) {

    byte temp = pgm_read_byte_near(ASCII + ((character - 0x20)*5) + i);
    LcdWriteData(temp);
  }
  LcdWriteData(0x00);
}

void LcdWriteData(byte dat)
{
  digitalWrite(DC, HIGH); //DC pin is low for commands
  shiftOut(DIN, CLK, MSBFIRST, dat); //transmit serial data
}

void LcdXY(int x, int y)
{
  LcdWriteCmd(0x80 | x);  // Column.
  LcdWriteCmd(0x40 | y);  // Row.
}

void LcdWriteCmd(byte cmd)
{
  digitalWrite(DC, LOW); //DC pin is low for commands
  shiftOut(DIN, CLK, MSBFIRST, cmd); //transmit serial data
}
